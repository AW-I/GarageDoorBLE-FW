## main/Kconfig.projbuild
```kconfig
menu "Garage Door Controller"

    menu "Motor UART"
        config GDC_MOTOR_UART_PORT
            int "UART port"
            range 0 2
            default 1
            help
                UART peripheral wired to the motor unit. UART0 is the console on most boards.

        config GDC_MOTOR_TX_GPIO
            int "TX GPIO (to motor D+)"
            default 1

        config GDC_MOTOR_RX_GPIO
            int "RX GPIO (from motor D-, via 5k/10k divider on 5 V motors)"
            default 0

        config GDC_MOTOR_BAUD
            int "Baud rate"
            default 115200

        config GDC_MOTOR_TX_GAP_MS
            int "Minimum gap between commands (ms)"
            default 100

        config GDC_MOTOR_TX_RETRIES
            int "Resend count when the motor does not echo a command"
            range 0 5
            default 0
            help
                The motor echoes every command it accepts. With a value above 0 the command is
                resent if no echo arrives within the echo timeout. 0 matches the ESPHome reference
                (send once).

        config GDC_MOTOR_ECHO_TIMEOUT_MS
            int "Echo timeout (ms)"
            default 500
    endmenu

    menu "Status LED"
        config GDC_STATUS_LED_GPIO
            int "Status LED GPIO (-1 = none)"
            range -1 21
            default 8
            help
                Plain LED. Off: no Wi-Fi configured. Blinking: searching for Wi-Fi.
                Double blink: Wi-Fi up, MQTT broker not connected. Solid: connected.
                A short flash marks each command sent to the motor.
                GPIO8 is a strapping pin on the C3 - fine as an output after boot.

        config GDC_STATUS_LED_ACTIVE_LOW
            bool "LED lights when the pin is low"
            default y
            help
                True for the blue LED on most ESP32-C3 SuperMini boards (GPIO8 to 3V3 via the LED).
    endmenu

    menu "Defaults"
        config GDC_DEFAULT_DEVICE_NAME
            string "Default BLE device name"
            default "BLEDoor"

        config GDC_DEFAULT_PASSWORD
            string "Default door password"
            default "default"
            help
                Used until a password is set from the app. Change it after first install.
    endmenu

    menu "Home Assistant (MQTT)"
        config GDC_HA_DISCOVERY_PREFIX
            string "Discovery prefix"
            default "homeassistant"

        config GDC_HA_BASE_TOPIC
            string "Base topic"
            default "garage_door"
            help
                State/command topics are <base>/<node_id>/...
    endmenu

    menu "Supervisor"
        config GDC_BLE_IDLE_TIMEOUT_S
            int "Disconnect idle BLE client after (s)"
            default 300
            help
                Frees the single BLE slot when a phone stops talking. Any write or state read
                counts as activity; the app reads the state every 60 s while it is open.

        config GDC_PERIODIC_REBOOT_H
            int "Periodic reboot interval (hours, 0 = never)"
            default 24
            help
                Reboot only happens while no phone is connected and the door is not moving.

        config GDC_OTA_CONFIRM_AFTER_S
            int "Keep a new firmware image after this much uptime (s, 0 = only on BLE login)"
            default 600
            help
                After a BLE update the new image runs in trial mode. A successful BLE AUTH keeps
                it straight away. Otherwise it is kept once it has run this long; if it crashes
                or resets before then, the bootloader goes back to the previous firmware.
    endmenu

endmenu
```
